/*
 * Copyright (c) 2020 The ZMK Contributors
 *
 * SPDX-License-Identifier: MIT
 */

#include <behaviors.dtsi>
#include <dt-bindings/zmk/bt.h>
#include <dt-bindings/zmk/keys.h>
#include <dt-bindings/zmk/outputs.h>
#include <dt-bindings/zmk/ext_power.h>

// CONFIG
#define COMBO_TIMEOUT 200
#define COMBO_LAYERS 0
#define STICKY_TIMEOUT 500

// LEFT SIDE
#define TLP 0 // TOP
#define TLR 1 // TOP
#define TLM 2 // TOP
#define TLI 3 // TOP
#define BLP 8 // BOTTOM
#define BLR 9 // BOTTOM
#define BLM 10 // BOTTOM
#define BLI 11 // BOTTOM
#define LOT 16 // O-THUMB
#define LIT 17 // I-THUMB

// RIGHT SIDE
#define TRP 7 // TOP
#define TRR 6 // TOP
#define TRM 5 // TOP
#define TRI 4 // TOP
#define BRP 15 // BOTTOM
#define BRR 14 // BOTTOM
#define BRM 13 // BOTTOM
#define BRI 12 // BOTTOM
#define ROT 19 // O-THUMB
#define RIT 18 // I-THUMB

&sk {
    release-after-ms = <STICKY_TIMEOUT>;
    quick-release;
};

/ {
  combos {
    compatible = "zmk,combos";

    combo_l_space { \
      timeout-ms = <200>; \
      bindings = <&kp SPACE>; \
      key-positions = <17>; \
      layers = <0>; \
    };

    combo_r_space { \
      timeout-ms = <200>; \
      bindings = <&kp SPACE>; \
      key-positions = <18>; \
      layers = <0>; \
    };

    combo_l_bspc { \
      timeout-ms = <200>; \
      bindings = <&kp BSPC>; \
      key-positions = <16>; \
      layers = <0>; \
    };

    combo_r_bspc { \
      timeout-ms = <200>; \
      bindings = <&kp BSPC>; \
      key-positions = <19>; \
      layers = <0>; \
    };

    combo_l_B { \
      timeout-ms = <200>; \
      bindings = <&kp B>; \
      key-positions = <0>; \
      layers = <0>; \
    }; \
    combo_li_B { \
      timeout-ms = <200>; \
      bindings = <&kp LS(B)>; \
      key-positions = <0 17>; \
      layers = <0>; \
    }; \
    combo_lo_B { \
      timeout-ms = <200>; \
      bindings = <&kp LEFT>; \
      key-positions = <0 16>; \
      layers = <0>; \
    }; \
    combo_lb_B { \
      timeout-ms = <200>; \
      bindings = <&kp LS(LEFT)>; \
      key-positions = <0 17 16>; \
      layers = <0>; \
    }; \
    combo_r_B { \
      timeout-ms = <200>; \
      bindings = <&kp B>; \
      key-positions = <7>; \
      layers = <0>; \
    }; \
    combo_ri_B { \
      timeout-ms = <200>; \
      bindings = <&kp LS(B)>; \
      key-positions = <7 18>; \
      layers = <0>; \
    }; \
    combo_ro_B { \
      timeout-ms = <200>; \
      bindings = <&kp LEFT>; \
      key-positions = <7 19>; \
      layers = <0>; \
    }; \
    combo_rb_B { \
      timeout-ms = <200>; \
      bindings = <&kp LS(LEFT)>; \
      key-positions = <7 18 19>; \
      layers = <0>; \
    };

    combo_l_F { \
      timeout-ms = <200>; \
      bindings = <&kp F>; \
      key-positions = <1>; \
      layers = <0>; \
    }; \
    combo_li_F { \
      timeout-ms = <200>; \
      bindings = <&kp LS(F)>; \
      key-positions = <1 17>; \
      layers = <0>; \
    }; \
    combo_lo_F { \
      timeout-ms = <200>; \
      bindings = <&kp UP>; \
      key-positions = <1 16>; \
      layers = <0>; \
    }; \
    combo_lb_F { \
      timeout-ms = <200>; \
      bindings = <&kp LS(UP)>; \
      key-positions = <1 17 16>; \
      layers = <0>; \
    }; \
    combo_r_F { \
      timeout-ms = <200>; \
      bindings = <&kp F>; \
      key-positions = <6>; \
      layers = <0>; \
    }; \
    combo_ri_F { \
      timeout-ms = <200>; \
      bindings = <&kp LS(F)>; \
      key-positions = <6 18>; \
      layers = <0>; \
    }; \
    combo_ro_F { \
      timeout-ms = <200>; \
      bindings = <&kp UP>; \
      key-positions = <6 19>; \
      layers = <0>; \
    }; \
    combo_rb_F { \
      timeout-ms = <200>; \
      bindings = <&kp LS(UP)>; \
      key-positions = <6 18 19>; \
      layers = <0>; \
    };

    combo_l_T { \
      timeout-ms = <200>; \
      bindings = <&kp T>; \
      key-positions = <2>; \
      layers = <0>; \
    }; \
    combo_li_T { \
      timeout-ms = <200>; \
      bindings = <&kp LS(T)>; \
      key-positions = <2 17>; \
      layers = <0>; \
    }; \
    combo_lo_T { \
      timeout-ms = <200>; \
      bindings = <&kp DOWN>; \
      key-positions = <2 16>; \
      layers = <0>; \
    }; \
    combo_lb_T { \
      timeout-ms = <200>; \
      bindings = <&kp LS(DOWN)>; \
      key-positions = <2 17 16>; \
      layers = <0>; \
    }; \
    combo_r_T { \
      timeout-ms = <200>; \
      bindings = <&kp T>; \
      key-positions = <5>; \
      layers = <0>; \
    }; \
    combo_ri_T { \
      timeout-ms = <200>; \
      bindings = <&kp LS(T)>; \
      key-positions = <5 18>; \
      layers = <0>; \
    }; \
    combo_ro_T { \
      timeout-ms = <200>; \
      bindings = <&kp DOWN>; \
      key-positions = <5 19>; \
      layers = <0>; \
    }; \
    combo_rb_T { \
      timeout-ms = <200>; \
      bindings = <&kp LS(DOWN)>; \
      key-positions = <5 18 19>; \
      layers = <0>; \
    };

    combo_l_J { \
      timeout-ms = <200>; \
      bindings = <&kp J>; \
      key-positions = <3>; \
      layers = <0>; \
    }; \
    combo_li_J { \
      timeout-ms = <200>; \
      bindings = <&kp LS(J)>; \
      key-positions = <3 17>; \
      layers = <0>; \
    }; \
    combo_lo_J { \
      timeout-ms = <200>; \
      bindings = <&kp RIGHT>; \
      key-positions = <3 16>; \
      layers = <0>; \
    }; \
    combo_lb_J { \
      timeout-ms = <200>; \
      bindings = <&kp LS(RIGHT)>; \
      key-positions = <3 17 16>; \
      layers = <0>; \
    }; \
    combo_r_J { \
      timeout-ms = <200>; \
      bindings = <&kp J>; \
      key-positions = <4>; \
      layers = <0>; \
    }; \
    combo_ri_J { \
      timeout-ms = <200>; \
      bindings = <&kp LS(J)>; \
      key-positions = <4 18>; \
      layers = <0>; \
    }; \
    combo_ro_J { \
      timeout-ms = <200>; \
      bindings = <&kp RIGHT>; \
      key-positions = <4 19>; \
      layers = <0>; \
    }; \
    combo_rb_J { \
      timeout-ms = <200>; \
      bindings = <&kp LS(RIGHT)>; \
      key-positions = <4 18 19>; \
      layers = <0>; \
    };

    combo_l_H { \
      timeout-ms = <200>; \
      bindings = <&kp H>; \
      key-positions = <8>; \
      layers = <0>; \
    }; \
    combo_li_H { \
      timeout-ms = <200>; \
      bindings = <&kp LS(H)>; \
      key-positions = <8 17>; \
      layers = <0>; \
    }; \
    combo_lo_H { \
      timeout-ms = <200>; \
      bindings = <&sk LGUI>; \
      key-positions = <8 16>; \
      layers = <0>; \
    }; \
    combo_lb_H { \
      timeout-ms = <200>; \
      bindings = <&kp HOME>; \
      key-positions = <8 17 16>; \
      layers = <0>; \
    }; \
    combo_r_H { \
      timeout-ms = <200>; \
      bindings = <&kp H>; \
      key-positions = <15>; \
      layers = <0>; \
    }; \
    combo_ri_H { \
      timeout-ms = <200>; \
      bindings = <&kp LS(H)>; \
      key-positions = <15 18>; \
      layers = <0>; \
    }; \
    combo_ro_H { \
      timeout-ms = <200>; \
      bindings = <&sk LGUI>; \
      key-positions = <15 19>; \
      layers = <0>; \
    }; \
    combo_rb_H { \
      timeout-ms = <200>; \
      bindings = <&kp HOME>; \
      key-positions = <15 18 19>; \
      layers = <0>; \
    };

    combo_l_C { \
      timeout-ms = <200>; \
      bindings = <&kp C>; \
      key-positions = <9>; \
      layers = <0>; \
    }; \
    combo_li_C { \
      timeout-ms = <200>; \
      bindings = <&kp LS(C)>; \
      key-positions = <9 17>; \
      layers = <0>; \
    }; \
    combo_lo_C { \
      timeout-ms = <200>; \
      bindings = <&sk LALT>; \
      key-positions = <9 16>; \
      layers = <0>; \
    }; \
    combo_lb_C { \
      timeout-ms = <200>; \
      bindings = <&kp PG_UP>; \
      key-positions = <9 17 16>; \
      layers = <0>; \
    }; \
    combo_r_C { \
      timeout-ms = <200>; \
      bindings = <&kp C>; \
      key-positions = <14>; \
      layers = <0>; \
    }; \
    combo_ri_C { \
      timeout-ms = <200>; \
      bindings = <&kp LS(C)>; \
      key-positions = <14 18>; \
      layers = <0>; \
    }; \
    combo_ro_C { \
      timeout-ms = <200>; \
      bindings = <&sk LALT>; \
      key-positions = <14 19>; \
      layers = <0>; \
    }; \
    combo_rb_C { \
      timeout-ms = <200>; \
      bindings = <&kp PG_UP>; \
      key-positions = <14 18 19>; \
      layers = <0>; \
    };

    combo_l_N { \
      timeout-ms = <200>; \
      bindings = <&kp N>; \
      key-positions = <10>; \
      layers = <0>; \
    }; \
    combo_li_N { \
      timeout-ms = <200>; \
      bindings = <&kp LS(N)>; \
      key-positions = <10 17>; \
      layers = <0>; \
    }; \
    combo_lo_N { \
      timeout-ms = <200>; \
      bindings = <&sk LCTRL>; \
      key-positions = <10 16>; \
      layers = <0>; \
    }; \
    combo_lb_N { \
      timeout-ms = <200>; \
      bindings = <&kp PG_DN>; \
      key-positions = <10 17 16>; \
      layers = <0>; \
    }; \
    combo_r_N { \
      timeout-ms = <200>; \
      bindings = <&kp N>; \
      key-positions = <13>; \
      layers = <0>; \
    }; \
    combo_ri_N { \
      timeout-ms = <200>; \
      bindings = <&kp LS(N)>; \
      key-positions = <13 18>; \
      layers = <0>; \
    }; \
    combo_ro_N { \
      timeout-ms = <200>; \
      bindings = <&sk LCTRL>; \
      key-positions = <13 19>; \
      layers = <0>; \
    }; \
    combo_rb_N { \
      timeout-ms = <200>; \
      bindings = <&kp PG_DN>; \
      key-positions = <13 18 19>; \
      layers = <0>; \
    };

    combo_l_Y { \
      timeout-ms = <200>; \
      bindings = <&kp Y>; \
      key-positions = <11>; \
      layers = <0>; \
    }; \
    combo_li_Y { \
      timeout-ms = <200>; \
      bindings = <&kp LS(Y)>; \
      key-positions = <11 17>; \
      layers = <0>; \
    }; \
    combo_lo_Y { \
      timeout-ms = <200>; \
      bindings = <&sk LSHIFT>; \
      key-positions = <11 16>; \
      layers = <0>; \
    }; \
    combo_lb_Y { \
      timeout-ms = <200>; \
      bindings = <&kp END>; \
      key-positions = <11 17 16>; \
      layers = <0>; \
    }; \
    combo_r_Y { \
      timeout-ms = <200>; \
      bindings = <&kp Y>; \
      key-positions = <12>; \
      layers = <0>; \
    }; \
    combo_ri_Y { \
      timeout-ms = <200>; \
      bindings = <&kp LS(Y)>; \
      key-positions = <12 18>; \
      layers = <0>; \
    }; \
    combo_ro_Y { \
      timeout-ms = <200>; \
      bindings = <&sk LSHIFT>; \
      key-positions = <12 19>; \
      layers = <0>; \
    }; \
    combo_rb_Y { \
      timeout-ms = <200>; \
      bindings = <&kp END>; \
      key-positions = <12 18 19>; \
      layers = <0>; \
    };

    combo_l_D { \
      timeout-ms = <200>; \
      bindings = <&kp D>; \
      key-positions = <0 3>; \
      layers = <0>; \
    }; \
    combo_li_D { \
      timeout-ms = <200>; \
      bindings = <&kp LS(D)>; \
      key-positions = <0 3 17>; \
      layers = <0>; \
    }; \
    combo_lo_D { \
      timeout-ms = <200>; \
      bindings = <&kp N1>; \
      key-positions = <0 3 16>; \
      layers = <0>; \
    }; \
    combo_lb_D { \
      timeout-ms = <200>; \
      bindings = <&kp F1>; \
      key-positions = <0 3 17 16>; \
      layers = <0>; \
    }; \
    combo_r_D { \
      timeout-ms = <200>; \
      bindings = <&kp D>; \
      key-positions = <7 4>; \
      layers = <0>; \
    }; \
    combo_ri_D { \
      timeout-ms = <200>; \
      bindings = <&kp LS(D)>; \
      key-positions = <7 4 18>; \
      layers = <0>; \
    }; \
    combo_ro_D { \
      timeout-ms = <200>; \
      bindings = <&kp N1>; \
      key-positions = <7 4 19>; \
      layers = <0>; \
    }; \
    combo_rb_D { \
      timeout-ms = <200>; \
      bindings = <&kp F1>; \
      key-positions = <7 4 18 19>; \
      layers = <0>; \
    };

    combo_l_K { \
      timeout-ms = <200>; \
      bindings = <&kp K>; \
      key-positions = <8 11>; \
      layers = <0>; \
    }; \
    combo_li_K { \
      timeout-ms = <200>; \
      bindings = <&kp LS(K)>; \
      key-positions = <8 11 17>; \
      layers = <0>; \
    }; \
    combo_lo_K { \
      timeout-ms = <200>; \
      bindings = <&kp N2>; \
      key-positions = <8 11 16>; \
      layers = <0>; \
    }; \
    combo_lb_K { \
      timeout-ms = <200>; \
      bindings = <&kp F2>; \
      key-positions = <8 11 17 16>; \
      layers = <0>; \
    }; \
    combo_r_K { \
      timeout-ms = <200>; \
      bindings = <&kp K>; \
      key-positions = <15 12>; \
      layers = <0>; \
    }; \
    combo_ri_K { \
      timeout-ms = <200>; \
      bindings = <&kp LS(K)>; \
      key-positions = <15 12 18>; \
      layers = <0>; \
    }; \
    combo_ro_K { \
      timeout-ms = <200>; \
      bindings = <&kp N2>; \
      key-positions = <15 12 19>; \
      layers = <0>; \
    }; \
    combo_rb_K { \
      timeout-ms = <200>; \
      bindings = <&kp F2>; \
      key-positions = <15 12 18 19>; \
      layers = <0>; \
    };

    combo_l_R { \
      timeout-ms = <200>; \
      bindings = <&kp R>; \
      key-positions = <8 9>; \
      layers = <0>; \
    }; \
    combo_li_R { \
      timeout-ms = <200>; \
      bindings = <&kp LS(R)>; \
      key-positions = <8 9 17>; \
      layers = <0>; \
    }; \
    combo_lo_R { \
      timeout-ms = <200>; \
      bindings = <&kp N3>; \
      key-positions = <8 9 16>; \
      layers = <0>; \
    }; \
    combo_lb_R { \
      timeout-ms = <200>; \
      bindings = <&kp F3>; \
      key-positions = <8 9 17 16>; \
      layers = <0>; \
    }; \
    combo_r_R { \
      timeout-ms = <200>; \
      bindings = <&kp R>; \
      key-positions = <15 14>; \
      layers = <0>; \
    }; \
    combo_ri_R { \
      timeout-ms = <200>; \
      bindings = <&kp LS(R)>; \
      key-positions = <15 14 18>; \
      layers = <0>; \
    }; \
    combo_ro_R { \
      timeout-ms = <200>; \
      bindings = <&kp N3>; \
      key-positions = <15 14 19>; \
      layers = <0>; \
    }; \
    combo_rb_R { \
      timeout-ms = <200>; \
      bindings = <&kp F3>; \
      key-positions = <15 14 18 19>; \
      layers = <0>; \
    };

    combo_l_V { \
      timeout-ms = <200>; \
      bindings = <&kp V>; \
      key-positions = <10 11>; \
      layers = <0>; \
    }; \
    combo_li_V { \
      timeout-ms = <200>; \
      bindings = <&kp LS(V)>; \
      key-positions = <10 11 17>; \
      layers = <0>; \
    }; \
    combo_lo_V { \
      timeout-ms = <200>; \
      bindings = <&kp N4>; \
      key-positions = <10 11 16>; \
      layers = <0>; \
    }; \
    combo_lb_V { \
      timeout-ms = <200>; \
      bindings = <&kp F4>; \
      key-positions = <10 11 17 16>; \
      layers = <0>; \
    }; \
    combo_r_V { \
      timeout-ms = <200>; \
      bindings = <&kp V>; \
      key-positions = <13 12>; \
      layers = <0>; \
    }; \
    combo_ri_V { \
      timeout-ms = <200>; \
      bindings = <&kp LS(V)>; \
      key-positions = <13 12 18>; \
      layers = <0>; \
    }; \
    combo_ro_V { \
      timeout-ms = <200>; \
      bindings = <&kp N4>; \
      key-positions = <13 12 19>; \
      layers = <0>; \
    }; \
    combo_rb_V { \
      timeout-ms = <200>; \
      bindings = <&kp F4>; \
      key-positions = <13 12 18 19>; \
      layers = <0>; \
    };

    combo_l_L { \
      timeout-ms = <200>; \
      bindings = <&kp L>; \
      key-positions = <0 1>; \
      layers = <0>; \
    }; \
    combo_li_L { \
      timeout-ms = <200>; \
      bindings = <&kp LS(L)>; \
      key-positions = <0 1 17>; \
      layers = <0>; \
    }; \
    combo_lo_L { \
      timeout-ms = <200>; \
      bindings = <&kp N5>; \
      key-positions = <0 1 16>; \
      layers = <0>; \
    }; \
    combo_lb_L { \
      timeout-ms = <200>; \
      bindings = <&kp F5>; \
      key-positions = <0 1 17 16>; \
      layers = <0>; \
    }; \
    combo_r_L { \
      timeout-ms = <200>; \
      bindings = <&kp L>; \
      key-positions = <7 6>; \
      layers = <0>; \
    }; \
    combo_ri_L { \
      timeout-ms = <200>; \
      bindings = <&kp LS(L)>; \
      key-positions = <7 6 18>; \
      layers = <0>; \
    }; \
    combo_ro_L { \
      timeout-ms = <200>; \
      bindings = <&kp N5>; \
      key-positions = <7 6 19>; \
      layers = <0>; \
    }; \
    combo_rb_L { \
      timeout-ms = <200>; \
      bindings = <&kp F5>; \
      key-positions = <7 6 18 19>; \
      layers = <0>; \
    };

    combo_l_G { \
      timeout-ms = <200>; \
      bindings = <&kp G>; \
      key-positions = <2 3>; \
      layers = <0>; \
    }; \
    combo_li_G { \
      timeout-ms = <200>; \
      bindings = <&kp LS(G)>; \
      key-positions = <2 3 17>; \
      layers = <0>; \
    }; \
    combo_lo_G { \
      timeout-ms = <200>; \
      bindings = <&kp N6>; \
      key-positions = <2 3 16>; \
      layers = <0>; \
    }; \
    combo_lb_G { \
      timeout-ms = <200>; \
      bindings = <&kp F6>; \
      key-positions = <2 3 17 16>; \
      layers = <0>; \
    }; \
    combo_r_G { \
      timeout-ms = <200>; \
      bindings = <&kp G>; \
      key-positions = <5 4>; \
      layers = <0>; \
    }; \
    combo_ri_G { \
      timeout-ms = <200>; \
      bindings = <&kp LS(G)>; \
      key-positions = <5 4 18>; \
      layers = <0>; \
    }; \
    combo_ro_G { \
      timeout-ms = <200>; \
      bindings = <&kp N6>; \
      key-positions = <5 4 19>; \
      layers = <0>; \
    }; \
    combo_rb_G { \
      timeout-ms = <200>; \
      bindings = <&kp F6>; \
      key-positions = <5 4 18 19>; \
      layers = <0>; \
    };

    combo_l_E { \
      timeout-ms = <200>; \
      bindings = <&kp E>; \
      key-positions = <9 10>; \
      layers = <0>; \
    }; \
    combo_li_E { \
      timeout-ms = <200>; \
      bindings = <&kp LS(E)>; \
      key-positions = <9 10 17>; \
      layers = <0>; \
    }; \
    combo_lo_E { \
      timeout-ms = <200>; \
      bindings = <&kp N7>; \
      key-positions = <9 10 16>; \
      layers = <0>; \
    }; \
    combo_lb_E { \
      timeout-ms = <200>; \
      bindings = <&kp F7>; \
      key-positions = <9 10 17 16>; \
      layers = <0>; \
    }; \
    combo_r_E { \
      timeout-ms = <200>; \
      bindings = <&kp E>; \
      key-positions = <14 13>; \
      layers = <0>; \
    }; \
    combo_ri_E { \
      timeout-ms = <200>; \
      bindings = <&kp LS(E)>; \
      key-positions = <14 13 18>; \
      layers = <0>; \
    }; \
    combo_ro_E { \
      timeout-ms = <200>; \
      bindings = <&kp N7>; \
      key-positions = <14 13 19>; \
      layers = <0>; \
    }; \
    combo_rb_E { \
      timeout-ms = <200>; \
      bindings = <&kp F7>; \
      key-positions = <14 13 18 19>; \
      layers = <0>; \
    };

    combo_l_Z { \
      timeout-ms = <200>; \
      bindings = <&kp Z>; \
      key-positions = <1 2>; \
      layers = <0>; \
    }; \
    combo_li_Z { \
      timeout-ms = <200>; \
      bindings = <&kp LS(Z)>; \
      key-positions = <1 2 17>; \
      layers = <0>; \
    }; \
    combo_lo_Z { \
      timeout-ms = <200>; \
      bindings = <&kp N8>; \
      key-positions = <1 2 16>; \
      layers = <0>; \
    }; \
    combo_lb_Z { \
      timeout-ms = <200>; \
      bindings = <&kp F8>; \
      key-positions = <1 2 17 16>; \
      layers = <0>; \
    }; \
    combo_r_Z { \
      timeout-ms = <200>; \
      bindings = <&kp Z>; \
      key-positions = <6 5>; \
      layers = <0>; \
    }; \
    combo_ri_Z { \
      timeout-ms = <200>; \
      bindings = <&kp LS(Z)>; \
      key-positions = <6 5 18>; \
      layers = <0>; \
    }; \
    combo_ro_Z { \
      timeout-ms = <200>; \
      bindings = <&kp N8>; \
      key-positions = <6 5 19>; \
      layers = <0>; \
    }; \
    combo_rb_Z { \
      timeout-ms = <200>; \
      bindings = <&kp F8>; \
      key-positions = <6 5 18 19>; \
      layers = <0>; \
    };

    combo_l_S { \
      timeout-ms = <200>; \
      bindings = <&kp S>; \
      key-positions = <8 10>; \
      layers = <0>; \
    }; \
    combo_li_S { \
      timeout-ms = <200>; \
      bindings = <&kp LS(S)>; \
      key-positions = <8 10 17>; \
      layers = <0>; \
    }; \
    combo_lo_S { \
      timeout-ms = <200>; \
      bindings = <&kp N9>; \
      key-positions = <8 10 16>; \
      layers = <0>; \
    }; \
    combo_lb_S { \
      timeout-ms = <200>; \
      bindings = <&kp F9>; \
      key-positions = <8 10 17 16>; \
      layers = <0>; \
    }; \
    combo_r_S { \
      timeout-ms = <200>; \
      bindings = <&kp S>; \
      key-positions = <15 13>; \
      layers = <0>; \
    }; \
    combo_ri_S { \
      timeout-ms = <200>; \
      bindings = <&kp LS(S)>; \
      key-positions = <15 13 18>; \
      layers = <0>; \
    }; \
    combo_ro_S { \
      timeout-ms = <200>; \
      bindings = <&kp N9>; \
      key-positions = <15 13 19>; \
      layers = <0>; \
    }; \
    combo_rb_S { \
      timeout-ms = <200>; \
      bindings = <&kp F9>; \
      key-positions = <15 13 18 19>; \
      layers = <0>; \
    };

    combo_l_M { \
      timeout-ms = <200>; \
      bindings = <&kp M>; \
      key-positions = <9 11>; \
      layers = <0>; \
    }; \
    combo_li_M { \
      timeout-ms = <200>; \
      bindings = <&kp LS(M)>; \
      key-positions = <9 11 17>; \
      layers = <0>; \
    }; \
    combo_lo_M { \
      timeout-ms = <200>; \
      bindings = <&kp N0>; \
      key-positions = <9 11 16>; \
      layers = <0>; \
    }; \
    combo_lb_M { \
      timeout-ms = <200>; \
      bindings = <&kp F10>; \
      key-positions = <9 11 17 16>; \
      layers = <0>; \
    }; \
    combo_r_M { \
      timeout-ms = <200>; \
      bindings = <&kp M>; \
      key-positions = <14 12>; \
      layers = <0>; \
    }; \
    combo_ri_M { \
      timeout-ms = <200>; \
      bindings = <&kp LS(M)>; \
      key-positions = <14 12 18>; \
      layers = <0>; \
    }; \
    combo_ro_M { \
      timeout-ms = <200>; \
      bindings = <&kp N0>; \
      key-positions = <14 12 19>; \
      layers = <0>; \
    }; \
    combo_rb_M { \
      timeout-ms = <200>; \
      bindings = <&kp F10>; \
      key-positions = <14 12 18 19>; \
      layers = <0>; \
    };

    combo_l_U { \
      timeout-ms = <200>; \
      bindings = <&kp U>; \
      key-positions = <0 2>; \
      layers = <0>; \
    }; \
    combo_li_U { \
      timeout-ms = <200>; \
      bindings = <&kp LS(U)>; \
      key-positions = <0 2 17>; \
      layers = <0>; \
    }; \
    combo_lo_U { \
      timeout-ms = <200>; \
      bindings = <&kp EXCL>; \
      key-positions = <0 2 16>; \
      layers = <0>; \
    }; \
    combo_lb_U { \
      timeout-ms = <200>; \
      bindings = <&kp F11>; \
      key-positions = <0 2 17 16>; \
      layers = <0>; \
    }; \
    combo_r_U { \
      timeout-ms = <200>; \
      bindings = <&kp U>; \
      key-positions = <7 5>; \
      layers = <0>; \
    }; \
    combo_ri_U { \
      timeout-ms = <200>; \
      bindings = <&kp LS(U)>; \
      key-positions = <7 5 18>; \
      layers = <0>; \
    }; \
    combo_ro_U { \
      timeout-ms = <200>; \
      bindings = <&kp EXCL>; \
      key-positions = <7 5 19>; \
      layers = <0>; \
    }; \
    combo_rb_U { \
      timeout-ms = <200>; \
      bindings = <&kp F11>; \
      key-positions = <7 5 18 19>; \
      layers = <0>; \
    };

    combo_l_P { \
      timeout-ms = <200>; \
      bindings = <&kp P>; \
      key-positions = <1 3>; \
      layers = <0>; \
    }; \
    combo_li_P { \
      timeout-ms = <200>; \
      bindings = <&kp LS(P)>; \
      key-positions = <1 3 17>; \
      layers = <0>; \
    }; \
    combo_lo_P { \
      timeout-ms = <200>; \
      bindings = <&kp AT>; \
      key-positions = <1 3 16>; \
      layers = <0>; \
    }; \
    combo_lb_P { \
      timeout-ms = <200>; \
      bindings = <&kp F12>; \
      key-positions = <1 3 17 16>; \
      layers = <0>; \
    }; \
    combo_r_P { \
      timeout-ms = <200>; \
      bindings = <&kp P>; \
      key-positions = <6 4>; \
      layers = <0>; \
    }; \
    combo_ri_P { \
      timeout-ms = <200>; \
      bindings = <&kp LS(P)>; \
      key-positions = <6 4 18>; \
      layers = <0>; \
    }; \
    combo_ro_P { \
      timeout-ms = <200>; \
      bindings = <&kp AT>; \
      key-positions = <6 4 19>; \
      layers = <0>; \
    }; \
    combo_rb_P { \
      timeout-ms = <200>; \
      bindings = <&kp F12>; \
      key-positions = <6 4 18 19>; \
      layers = <0>; \
    };

    combo_l_COMMA { \
      timeout-ms = <200>; \
      bindings = <&kp COMMA>; \
      key-positions = <0 11>; \
      layers = <0>; \
    }; \
    combo_li_COMMA { \
      timeout-ms = <200>; \
      bindings = <&kp LS(COMMA)>; \
      key-positions = <0 11 17>; \
      layers = <0>; \
    }; \
    combo_lo_COMMA { \
      timeout-ms = <200>; \
      bindings = <&kp HASH>; \
      key-positions = <0 11 16>; \
      layers = <0>; \
    }; \
    combo_lb_COMMA { \
      timeout-ms = <200>; \
      bindings = <&none>; \
      key-positions = <0 11 17 16>; \
      layers = <0>; \
    }; \
    combo_r_COMMA { \
      timeout-ms = <200>; \
      bindings = <&kp COMMA>; \
      key-positions = <7 12>; \
      layers = <0>; \
    }; \
    combo_ri_COMMA { \
      timeout-ms = <200>; \
      bindings = <&kp LS(COMMA)>; \
      key-positions = <7 12 18>; \
      layers = <0>; \
    }; \
    combo_ro_COMMA { \
      timeout-ms = <200>; \
      bindings = <&kp HASH>; \
      key-positions = <7 12 19>; \
      layers = <0>; \
    }; \
    combo_rb_COMMA { \
      timeout-ms = <200>; \
      bindings = <&none>; \
      key-positions = <7 12 18 19>; \
      layers = <0>; \
    };

    combo_l_X { \
      timeout-ms = <200>; \
      bindings = <&kp X>; \
      key-positions = <8 3>; \
      layers = <0>; \
    }; \
    combo_li_X { \
      timeout-ms = <200>; \
      bindings = <&kp LS(X)>; \
      key-positions = <8 3 17>; \
      layers = <0>; \
    }; \
    combo_lo_X { \
      timeout-ms = <200>; \
      bindings = <&kp DLLR>; \
      key-positions = <8 3 16>; \
      layers = <0>; \
    }; \
    combo_lb_X { \
      timeout-ms = <200>; \
      bindings = <&none>; \
      key-positions = <8 3 17 16>; \
      layers = <0>; \
    }; \
    combo_r_X { \
      timeout-ms = <200>; \
      bindings = <&kp X>; \
      key-positions = <15 4>; \
      layers = <0>; \
    }; \
    combo_ri_X { \
      timeout-ms = <200>; \
      bindings = <&kp LS(X)>; \
      key-positions = <15 4 18>; \
      layers = <0>; \
    }; \
    combo_ro_X { \
      timeout-ms = <200>; \
      bindings = <&kp DLLR>; \
      key-positions = <15 4 19>; \
      layers = <0>; \
    }; \
    combo_rb_X { \
      timeout-ms = <200>; \
      bindings = <&none>; \
      key-positions = <15 4 18 19>; \
      layers = <0>; \
    };

    combo_l_Q { \
      timeout-ms = <200>; \
      bindings = <&kp Q>; \
      key-positions = <0 10>; \
      layers = <0>; \
    }; \
    combo_li_Q { \
      timeout-ms = <200>; \
      bindings = <&kp LS(Q)>; \
      key-positions = <0 10 17>; \
      layers = <0>; \
    }; \
    combo_lo_Q { \
      timeout-ms = <200>; \
      bindings = <&kp PRCNT>; \
      key-positions = <0 10 16>; \
      layers = <0>; \
    }; \
    combo_lb_Q { \
      timeout-ms = <200>; \
      bindings = <&none>; \
      key-positions = <0 10 17 16>; \
      layers = <0>; \
    }; \
    combo_r_Q { \
      timeout-ms = <200>; \
      bindings = <&kp Q>; \
      key-positions = <7 13>; \
      layers = <0>; \
    }; \
    combo_ri_Q { \
      timeout-ms = <200>; \
      bindings = <&kp LS(Q)>; \
      key-positions = <7 13 18>; \
      layers = <0>; \
    }; \
    combo_ro_Q { \
      timeout-ms = <200>; \
      bindings = <&kp PRCNT>; \
      key-positions = <7 13 19>; \
      layers = <0>; \
    }; \
    combo_rb_Q { \
      timeout-ms = <200>; \
      bindings = <&none>; \
      key-positions = <7 13 18 19>; \
      layers = <0>; \
    };

    combo_l_LBKT { \
      timeout-ms = <200>; \
      bindings = <&kp LBKT>; \
      key-positions = <9 3>; \
      layers = <0>; \
    }; \
    combo_li_LBKT { \
      timeout-ms = <200>; \
      bindings = <&kp LS(LBKT)>; \
      key-positions = <9 3 17>; \
      layers = <0>; \
    }; \
    combo_lo_LBKT { \
      timeout-ms = <200>; \
      bindings = <&kp CARET>; \
      key-positions = <9 3 16>; \
      layers = <0>; \
    }; \
    combo_lb_LBKT { \
      timeout-ms = <200>; \
      bindings = <&none>; \
      key-positions = <9 3 17 16>; \
      layers = <0>; \
    }; \
    combo_r_LBKT { \
      timeout-ms = <200>; \
      bindings = <&kp LBKT>; \
      key-positions = <14 4>; \
      layers = <0>; \
    }; \
    combo_ri_LBKT { \
      timeout-ms = <200>; \
      bindings = <&kp LS(LBKT)>; \
      key-positions = <14 4 18>; \
      layers = <0>; \
    }; \
    combo_ro_LBKT { \
      timeout-ms = <200>; \
      bindings = <&kp CARET>; \
      key-positions = <14 4 19>; \
      layers = <0>; \
    }; \
    combo_rb_LBKT { \
      timeout-ms = <200>; \
      bindings = <&none>; \
      key-positions = <14 4 18 19>; \
      layers = <0>; \
    };

    combo_l_SEMI { \
      timeout-ms = <200>; \
      bindings = <&kp SEMI>; \
      key-positions = <8 2>; \
      layers = <0>; \
    }; \
    combo_li_SEMI { \
      timeout-ms = <200>; \
      bindings = <&kp LS(SEMI)>; \
      key-positions = <8 2 17>; \
      layers = <0>; \
    }; \
    combo_lo_SEMI { \
      timeout-ms = <200>; \
      bindings = <&kp AMPS>; \
      key-positions = <8 2 16>; \
      layers = <0>; \
    }; \
    combo_lb_SEMI { \
      timeout-ms = <200>; \
      bindings = <&none>; \
      key-positions = <8 2 17 16>; \
      layers = <0>; \
    }; \
    combo_r_SEMI { \
      timeout-ms = <200>; \
      bindings = <&kp SEMI>; \
      key-positions = <15 5>; \
      layers = <0>; \
    }; \
    combo_ri_SEMI { \
      timeout-ms = <200>; \
      bindings = <&kp LS(SEMI)>; \
      key-positions = <15 5 18>; \
      layers = <0>; \
    }; \
    combo_ro_SEMI { \
      timeout-ms = <200>; \
      bindings = <&kp AMPS>; \
      key-positions = <15 5 19>; \
      layers = <0>; \
    }; \
    combo_rb_SEMI { \
      timeout-ms = <200>; \
      bindings = <&none>; \
      key-positions = <15 5 18 19>; \
      layers = <0>; \
    };

    combo_l_I { \
      timeout-ms = <200>; \
      bindings = <&kp I>; \
      key-positions = <1 11>; \
      layers = <0>; \
    }; \
    combo_li_I { \
      timeout-ms = <200>; \
      bindings = <&kp LS(I)>; \
      key-positions = <1 11 17>; \
      layers = <0>; \
    }; \
    combo_lo_I { \
      timeout-ms = <200>; \
      bindings = <&kp STAR>; \
      key-positions = <1 11 16>; \
      layers = <0>; \
    }; \
    combo_lb_I { \
      timeout-ms = <200>; \
      bindings = <&none>; \
      key-positions = <1 11 17 16>; \
      layers = <0>; \
    }; \
    combo_r_I { \
      timeout-ms = <200>; \
      bindings = <&kp I>; \
      key-positions = <6 12>; \
      layers = <0>; \
    }; \
    combo_ri_I { \
      timeout-ms = <200>; \
      bindings = <&kp LS(I)>; \
      key-positions = <6 12 18>; \
      layers = <0>; \
    }; \
    combo_ro_I { \
      timeout-ms = <200>; \
      bindings = <&kp STAR>; \
      key-positions = <6 12 19>; \
      layers = <0>; \
    }; \
    combo_rb_I { \
      timeout-ms = <200>; \
      bindings = <&none>; \
      key-positions = <6 12 18 19>; \
      layers = <0>; \
    };

    combo_l_DOT { \
      timeout-ms = <200>; \
      bindings = <&kp DOT>; \
      key-positions = <0 9>; \
      layers = <0>; \
    }; \
    combo_li_DOT { \
      timeout-ms = <200>; \
      bindings = <&kp LS(DOT)>; \
      key-positions = <0 9 17>; \
      layers = <0>; \
    }; \
    combo_lo_DOT { \
      timeout-ms = <200>; \
      bindings = <&kp LPAR>; \
      key-positions = <0 9 16>; \
      layers = <0>; \
    }; \
    combo_lb_DOT { \
      timeout-ms = <200>; \
      bindings = <&none>; \
      key-positions = <0 9 17 16>; \
      layers = <0>; \
    }; \
    combo_r_DOT { \
      timeout-ms = <200>; \
      bindings = <&kp DOT>; \
      key-positions = <7 14>; \
      layers = <0>; \
    }; \
    combo_ri_DOT { \
      timeout-ms = <200>; \
      bindings = <&kp LS(DOT)>; \
      key-positions = <7 14 18>; \
      layers = <0>; \
    }; \
    combo_ro_DOT { \
      timeout-ms = <200>; \
      bindings = <&kp LPAR>; \
      key-positions = <7 14 19>; \
      layers = <0>; \
    }; \
    combo_rb_DOT { \
      timeout-ms = <200>; \
      bindings = <&none>; \
      key-positions = <7 14 18 19>; \
      layers = <0>; \
    };

    combo_l_W { \
      timeout-ms = <200>; \
      bindings = <&kp W>; \
      key-positions = <3 10>; \
      layers = <0>; \
    }; \
    combo_li_W { \
      timeout-ms = <200>; \
      bindings = <&kp LS(W)>; \
      key-positions = <3 10 17>; \
      layers = <0>; \
    }; \
    combo_lo_W { \
      timeout-ms = <200>; \
      bindings = <&kp RPAR>; \
      key-positions = <3 10 16>; \
      layers = <0>; \
    }; \
    combo_lb_W { \
      timeout-ms = <200>; \
      bindings = <&none>; \
      key-positions = <3 10 17 16>; \
      layers = <0>; \
    }; \
    combo_r_W { \
      timeout-ms = <200>; \
      bindings = <&kp W>; \
      key-positions = <4 13>; \
      layers = <0>; \
    }; \
    combo_ri_W { \
      timeout-ms = <200>; \
      bindings = <&kp LS(W)>; \
      key-positions = <4 13 18>; \
      layers = <0>; \
    }; \
    combo_ro_W { \
      timeout-ms = <200>; \
      bindings = <&kp RPAR>; \
      key-positions = <4 13 19>; \
      layers = <0>; \
    }; \
    combo_rb_W { \
      timeout-ms = <200>; \
      bindings = <&none>; \
      key-positions = <4 13 18 19>; \
      layers = <0>; \
    };

    combo_l_O { \
      timeout-ms = <200>; \
      bindings = <&kp O>; \
      key-positions = <1 10>; \
      layers = <0>; \
    }; \
    combo_li_O { \
      timeout-ms = <200>; \
      bindings = <&kp LS(O)>; \
      key-positions = <1 10 17>; \
      layers = <0>; \
    }; \
    combo_lo_O { \
      timeout-ms = <200>; \
      bindings = <&kp SLASH>; \
      key-positions = <1 10 16>; \
      layers = <0>; \
    }; \
    combo_lb_O { \
      timeout-ms = <200>; \
      bindings = <&none>; \
      key-positions = <1 10 17 16>; \
      layers = <0>; \
    }; \
    combo_r_O { \
      timeout-ms = <200>; \
      bindings = <&kp O>; \
      key-positions = <6 13>; \
      layers = <0>; \
    }; \
    combo_ri_O { \
      timeout-ms = <200>; \
      bindings = <&kp LS(O)>; \
      key-positions = <6 13 18>; \
      layers = <0>; \
    }; \
    combo_ro_O { \
      timeout-ms = <200>; \
      bindings = <&kp SLASH>; \
      key-positions = <6 13 19>; \
      layers = <0>; \
    }; \
    combo_rb_O { \
      timeout-ms = <200>; \
      bindings = <&none>; \
      key-positions = <6 13 18 19>; \
      layers = <0>; \
    };

    combo_l_SQT { \
      timeout-ms = <200>; \
      bindings = <&kp SQT>; \
      key-positions = <2 9>; \
      layers = <0>; \
    }; \
    combo_li_SQT { \
      timeout-ms = <200>; \
      bindings = <&kp LS(SQT)>; \
      key-positions = <2 9 17>; \
      layers = <0>; \
    }; \
    combo_lo_SQT { \
      timeout-ms = <200>; \
      bindings = <&kp QMARK>; \
      key-positions = <2 9 16>; \
      layers = <0>; \
    }; \
    combo_lb_SQT { \
      timeout-ms = <200>; \
      bindings = <&none>; \
      key-positions = <2 9 17 16>; \
      layers = <0>; \
    }; \
    combo_r_SQT { \
      timeout-ms = <200>; \
      bindings = <&kp SQT>; \
      key-positions = <5 14>; \
      layers = <0>; \
    }; \
    combo_ri_SQT { \
      timeout-ms = <200>; \
      bindings = <&kp LS(SQT)>; \
      key-positions = <5 14 18>; \
      layers = <0>; \
    }; \
    combo_ro_SQT { \
      timeout-ms = <200>; \
      bindings = <&kp QMARK>; \
      key-positions = <5 14 19>; \
      layers = <0>; \
    }; \
    combo_rb_SQT { \
      timeout-ms = <200>; \
      bindings = <&none>; \
      key-positions = <5 14 18 19>; \
      layers = <0>; \
    };

    combo_l_A { \
      timeout-ms = <200>; \
      bindings = <&kp A>; \
      key-positions = <2 11>; \
      layers = <0>; \
    }; \
    combo_li_A { \
      timeout-ms = <200>; \
      bindings = <&kp LS(A)>; \
      key-positions = <2 11 17>; \
      layers = <0>; \
    }; \
    combo_lo_A { \
      timeout-ms = <200>; \
      bindings = <&kp MINUS>; \
      key-positions = <2 11 16>; \
      layers = <0>; \
    }; \
    combo_lb_A { \
      timeout-ms = <200>; \
      bindings = <&none>; \
      key-positions = <2 11 17 16>; \
      layers = <0>; \
    }; \
    combo_r_A { \
      timeout-ms = <200>; \
      bindings = <&kp A>; \
      key-positions = <5 12>; \
      layers = <0>; \
    }; \
    combo_ri_A { \
      timeout-ms = <200>; \
      bindings = <&kp LS(A)>; \
      key-positions = <5 12 18>; \
      layers = <0>; \
    }; \
    combo_ro_A { \
      timeout-ms = <200>; \
      bindings = <&kp MINUS>; \
      key-positions = <5 12 19>; \
      layers = <0>; \
    }; \
    combo_rb_A { \
      timeout-ms = <200>; \
      bindings = <&none>; \
      key-positions = <5 12 18 19>; \
      layers = <0>; \
    };

    combo_l_RBKT { \
      timeout-ms = <200>; \
      bindings = <&kp RBKT>; \
      key-positions = <1 8>; \
      layers = <0>; \
    }; \
    combo_li_RBKT { \
      timeout-ms = <200>; \
      bindings = <&kp LS(RBKT)>; \
      key-positions = <1 8 17>; \
      layers = <0>; \
    }; \
    combo_lo_RBKT { \
      timeout-ms = <200>; \
      bindings = <&kp UNDER>; \
      key-positions = <1 8 16>; \
      layers = <0>; \
    }; \
    combo_lb_RBKT { \
      timeout-ms = <200>; \
      bindings = <&none>; \
      key-positions = <1 8 17 16>; \
      layers = <0>; \
    }; \
    combo_r_RBKT { \
      timeout-ms = <200>; \
      bindings = <&kp RBKT>; \
      key-positions = <6 15>; \
      layers = <0>; \
    }; \
    combo_ri_RBKT { \
      timeout-ms = <200>; \
      bindings = <&kp LS(RBKT)>; \
      key-positions = <6 15 18>; \
      layers = <0>; \
    }; \
    combo_ro_RBKT { \
      timeout-ms = <200>; \
      bindings = <&kp UNDER>; \
      key-positions = <6 15 19>; \
      layers = <0>; \
    }; \
    combo_rb_RBKT { \
      timeout-ms = <200>; \
      bindings = <&none>; \
      key-positions = <6 15 18 19>; \
      layers = <0>; \
    };

    combo_l_GRAVE { \
      timeout-ms = <200>; \
      bindings = <&kp GRAVE>; \
      key-positions = <1 2 3>; \
      layers = <0>; \
    }; \
    combo_li_GRAVE { \
      timeout-ms = <200>; \
      bindings = <&kp LS(GRAVE)>; \
      key-positions = <1 2 3 17>; \
      layers = <0>; \
    }; \
    combo_lo_GRAVE { \
      timeout-ms = <200>; \
      bindings = <&kp EQUAL>; \
      key-positions = <1 2 3 16>; \
      layers = <0>; \
    }; \
    combo_lb_GRAVE { \
      timeout-ms = <200>; \
      bindings = <&none>; \
      key-positions = <1 2 3 17 16>; \
      layers = <0>; \
    }; \
    combo_r_GRAVE { \
      timeout-ms = <200>; \
      bindings = <&kp GRAVE>; \
      key-positions = <6 5 4>; \
      layers = <0>; \
    }; \
    combo_ri_GRAVE { \
      timeout-ms = <200>; \
      bindings = <&kp LS(GRAVE)>; \
      key-positions = <6 5 4 18>; \
      layers = <0>; \
    }; \
    combo_ro_GRAVE { \
      timeout-ms = <200>; \
      bindings = <&kp EQUAL>; \
      key-positions = <6 5 4 19>; \
      layers = <0>; \
    }; \
    combo_rb_GRAVE { \
      timeout-ms = <200>; \
      bindings = <&none>; \
      key-positions = <6 5 4 18 19>; \
      layers = <0>; \
    };

    combo_l_NUBS { \
      timeout-ms = <200>; \
      bindings = <&kp NUBS>; \
      key-positions = <9 10 11>; \
      layers = <0>; \
    }; \
    combo_li_NUBS { \
      timeout-ms = <200>; \
      bindings = <&kp LS(NUBS)>; \
      key-positions = <9 10 11 17>; \
      layers = <0>; \
    }; \
    combo_lo_NUBS { \
      timeout-ms = <200>; \
      bindings = <&kp PLUS>; \
      key-positions = <9 10 11 16>; \
      layers = <0>; \
    }; \
    combo_lb_NUBS { \
      timeout-ms = <200>; \
      bindings = <&none>; \
      key-positions = <9 10 11 17 16>; \
      layers = <0>; \
    }; \
    combo_r_NUBS { \
      timeout-ms = <200>; \
      bindings = <&kp NUBS>; \
      key-positions = <14 13 12>; \
      layers = <0>; \
    }; \
    combo_ri_NUBS { \
      timeout-ms = <200>; \
      bindings = <&kp LS(NUBS)>; \
      key-positions = <14 13 12 18>; \
      layers = <0>; \
    }; \
    combo_ro_NUBS { \
      timeout-ms = <200>; \
      bindings = <&kp PLUS>; \
      key-positions = <14 13 12 19>; \
      layers = <0>; \
    }; \
    combo_rb_NUBS { \
      timeout-ms = <200>; \
      bindings = <&none>; \
      key-positions = <14 13 12 18 19>; \
      layers = <0>; \
    };

    combo_l_DEL { \
      timeout-ms = <200>; \
      bindings = <&kp DEL>; \
      key-positions = <1 9>; \
      layers = <0>; \
    }; \
    combo_li_DEL { \
      timeout-ms = <200>; \
      bindings = <&none>; \
      key-positions = <1 9 17>; \
      layers = <0>; \
    }; \
    combo_lo_DEL { \
      timeout-ms = <200>; \
      bindings = <&kp LC(DEL)>; \
      key-positions = <1 9 16>; \
      layers = <0>; \
    }; \
    combo_lb_DEL { \
      timeout-ms = <200>; \
      bindings = <&none>; \
      key-positions = <1 9 17 16>; \
      layers = <0>; \
    }; \
    combo_r_DEL { \
      timeout-ms = <200>; \
      bindings = <&kp DEL>; \
      key-positions = <6 14>; \
      layers = <0>; \
    }; \
    combo_ri_DEL { \
      timeout-ms = <200>; \
      bindings = <&none>; \
      key-positions = <6 14 18>; \
      layers = <0>; \
    }; \
    combo_ro_DEL { \
      timeout-ms = <200>; \
      bindings = <&kp LC(DEL)>; \
      key-positions = <6 14 19>; \
      layers = <0>; \
    }; \
    combo_rb_DEL { \
      timeout-ms = <200>; \
      bindings = <&none>; \
      key-positions = <6 14 18 19>; \
      layers = <0>; \
    };

    combo_l_ESC { \
      timeout-ms = <200>; \
      bindings = <&kp ESC>; \
      key-positions = <2 10>; \
      layers = <0>; \
    }; \
    combo_li_ESC { \
      timeout-ms = <200>; \
      bindings = <&none>; \
      key-positions = <2 10 17>; \
      layers = <0>; \
    }; \
    combo_lo_ESC { \
      timeout-ms = <200>; \
      bindings = <&kp N1>; \
      key-positions = <2 10 16>; \
      layers = <0>; \
    }; \
    combo_lb_ESC { \
      timeout-ms = <200>; \
      bindings = <&none>; \
      key-positions = <2 10 17 16>; \
      layers = <0>; \
    }; \
    combo_r_ESC { \
      timeout-ms = <200>; \
      bindings = <&kp ESC>; \
      key-positions = <5 13>; \
      layers = <0>; \
    }; \
    combo_ri_ESC { \
      timeout-ms = <200>; \
      bindings = <&none>; \
      key-positions = <5 13 18>; \
      layers = <0>; \
    }; \
    combo_ro_ESC { \
      timeout-ms = <200>; \
      bindings = <&kp N1>; \
      key-positions = <5 13 19>; \
      layers = <0>; \
    }; \
    combo_rb_ESC { \
      timeout-ms = <200>; \
      bindings = <&none>; \
      key-positions = <5 13 18 19>; \
      layers = <0>; \
    };

    combo_l_TAB { \
      timeout-ms = <200>; \
      bindings = <&kp TAB>; \
      key-positions = <0 8>; \
      layers = <0>; \
    }; \
    combo_li_TAB { \
      timeout-ms = <200>; \
      bindings = <&kp LA(TAB)>; \
      key-positions = <0 8 17>; \
      layers = <0>; \
    }; \
    combo_lo_TAB { \
      timeout-ms = <200>; \
      bindings = <&kp LC(TAB)>; \
      key-positions = <0 8 16>; \
      layers = <0>; \
    }; \
    combo_lb_TAB { \
      timeout-ms = <200>; \
      bindings = <&none>; \
      key-positions = <0 8 17 16>; \
      layers = <0>; \
    }; \
    combo_r_TAB { \
      timeout-ms = <200>; \
      bindings = <&kp TAB>; \
      key-positions = <7 15>; \
      layers = <0>; \
    }; \
    combo_ri_TAB { \
      timeout-ms = <200>; \
      bindings = <&kp LA(TAB)>; \
      key-positions = <7 15 18>; \
      layers = <0>; \
    }; \
    combo_ro_TAB { \
      timeout-ms = <200>; \
      bindings = <&kp LC(TAB)>; \
      key-positions = <7 15 19>; \
      layers = <0>; \
    }; \
    combo_rb_TAB { \
      timeout-ms = <200>; \
      bindings = <&none>; \
      key-positions = <7 15 18 19>; \
      layers = <0>; \
    };

    combo_l_ENTER { \
      timeout-ms = <200>; \
      bindings = <&kp ENTER>; \
      key-positions = <3 11>; \
      layers = <0>; \
    }; \
    combo_li_ENTER { \
      timeout-ms = <200>; \
      bindings = <&kp LS(ENTER)>; \
      key-positions = <3 11 17>; \
      layers = <0>; \
    }; \
    combo_lo_ENTER { \
      timeout-ms = <200>; \
      bindings = <&none>; \
      key-positions = <3 11 16>; \
      layers = <0>; \
    }; \
    combo_lb_ENTER { \
      timeout-ms = <200>; \
      bindings = <&none>; \
      key-positions = <3 11 17 16>; \
      layers = <0>; \
    }; \
    combo_r_ENTER { \
      timeout-ms = <200>; \
      bindings = <&kp ENTER>; \
      key-positions = <4 12>; \
      layers = <0>; \
    }; \
    combo_ri_ENTER { \
      timeout-ms = <200>; \
      bindings = <&kp LS(ENTER)>; \
      key-positions = <4 12 18>; \
      layers = <0>; \
    }; \
    combo_ro_ENTER { \
      timeout-ms = <200>; \
      bindings = <&none>; \
      key-positions = <4 12 19>; \
      layers = <0>; \
    }; \
    combo_rb_ENTER { \
      timeout-ms = <200>; \
      bindings = <&none>; \
      key-positions = <4 12 18 19>; \
      layers = <0>; \
    };

    combo_l_boot { \
      timeout-ms = <200>; \
      bindings = <&none>; \
      key-positions = <0 1 2 3>; \
      layers = <0>; \
    }; \
    combo_li_boot { \
      timeout-ms = <200>; \
      bindings = <&none>; \
      key-positions = <0 1 2 3 17>; \
      layers = <0>; \
    }; \
    combo_lo_boot { \
      timeout-ms = <200>; \
      bindings = <&ext_power EP_OFF>; \
      key-positions = <0 1 2 3 16>; \
      layers = <0>; \
    }; \
    combo_lb_boot { \
      timeout-ms = <200>; \
      bindings = <&bootloader>; \
      key-positions = <0 1 2 3 17 16>; \
      layers = <0>; \
    }; \
    combo_r_boot { \
      timeout-ms = <200>; \
      bindings = <&none>; \
      key-positions = <7 6 5 4>; \
      layers = <0>; \
    }; \
    combo_ri_boot { \
      timeout-ms = <200>; \
      bindings = <&none>; \
      key-positions = <7 6 5 4 18>; \
      layers = <0>; \
    }; \
    combo_ro_boot { \
      timeout-ms = <200>; \
      bindings = <&ext_power EP_OFF>; \
      key-positions = <7 6 5 4 19>; \
      layers = <0>; \
    }; \
    combo_rb_boot { \
      timeout-ms = <200>; \
      bindings = <&bootloader>; \
      key-positions = <7 6 5 4 18 19>; \
      layers = <0>; \
    };

    combo_l_BT { \
      timeout-ms = <200>; \
      bindings = <&bt BT_SEL 0>; \
      key-positions = <8 9 10 11>; \
      layers = <0>; \
    }; \
    combo_li_BT { \
      timeout-ms = <200>; \
      bindings = <&bt BT_SEL 1>; \
      key-positions = <8 9 10 11 17>; \
      layers = <0>; \
    }; \
    combo_lo_BT { \
      timeout-ms = <200>; \
      bindings = <&bt BT_SEL 2>; \
      key-positions = <8 9 10 11 16>; \
      layers = <0>; \
    }; \
    combo_lb_BT { \
      timeout-ms = <200>; \
      bindings = <&bt BT_CLR>; \
      key-positions = <8 9 10 11 17 16>; \
      layers = <0>; \
    }; \
    combo_r_BT { \
      timeout-ms = <200>; \
      bindings = <&bt BT_SEL 0>; \
      key-positions = <15 14 13 12>; \
      layers = <0>; \
    }; \
    combo_ri_BT { \
      timeout-ms = <200>; \
      bindings = <&bt BT_SEL 1>; \
      key-positions = <15 14 13 12 18>; \
      layers = <0>; \
    }; \
    combo_ro_BT { \
      timeout-ms = <200>; \
      bindings = <&bt BT_SEL 2>; \
      key-positions = <15 14 13 12 19>; \
      layers = <0>; \
    }; \
    combo_rb_BT { \
      timeout-ms = <200>; \
      bindings = <&bt BT_CLR>; \
      key-positions = <15 14 13 12 18 19>; \
      layers = <0>; \
    };


  };

  keymap {
    compatible = "zmk,keymap";

    default_layer {
      bindings = <
        &none &none &none &none               &none &none &none &none
        &none &none &none &none               &none &none &none &none
                          &none &none   &none &none
      >;
    };
  };
};
